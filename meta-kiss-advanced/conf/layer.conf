## meta-kiss-advanced/conf/layer.conf
```bitbake
# We have a conf and classes directory, add to BBPATH
BBPATH .= ":${LAYERDIR}"

# We have recipes-* directories, add to BBFILES
BBFILES += "${LAYERDIR}/recipes-*/*/*.bb \
            ${LAYERDIR}/recipes-*/*/*.bbappend"

BBFILE_COLLECTIONS += "meta-kiss-advanced"
BBFILE_PATTERN_meta-kiss-advanced = "^${LAYERDIR}/"
BBFILE_PRIORITY_meta-kiss-advanced = "9"

LAYERDEPENDS_meta-kiss-advanced = "core meta-arm meta-kiss"
LAYERSERIES_COMPAT_meta-kiss-advanced = "scarthgap"
```

## meta-kiss-amd/conf/layer.conf
```bitbake
# We have a conf and classes directory, add to BBPATH
BBPATH .= ":${LAYERDIR}"

# We have recipes-* directories, add to BBFILES
BBFILES += "${LAYERDIR}/recipes-*/*/*.bb \
            ${LAYERDIR}/recipes-*/*/*.bbappend"

BBFILE_COLLECTIONS += "meta-kiss-amd"
BBFILE_PATTERN_meta-kiss-amd = "^${LAYERDIR}/"
BBFILE_PRIORITY_meta-kiss-amd = "9"

LAYERDEPENDS_meta-kiss-amd = "core meta-arm meta-kiss meta-python"
LAYERSERIES_COMPAT_meta-kiss-amd = "scarthgap"
```

## meta-kiss-nxp/conf/layer.conf
```bitbake
# We have a conf and classes directory, add to BBPATH
BBPATH .= ":${LAYERDIR}"

# We have recipes-* directories, add to BBFILES
BBFILES += "${LAYERDIR}/recipes-*/*/*.bb \
            ${LAYERDIR}/recipes-*/*/*.bbappend"

BBFILE_COLLECTIONS += "meta-kiss-nxp"
BBFILE_PATTERN_meta-kiss-nxp = "^${LAYERDIR}/"
BBFILE_PRIORITY_meta-kiss-nxp = "9"

LAYERDEPENDS_meta-kiss-nxp = "core meta-arm meta-kiss"
LAYERSERIES_COMPAT_meta-kiss-nxp = "scarthgap"
```

## meta-kiss-st/conf/layer.conf
```bitbake
# We have a conf and classes directory, add to BBPATH
BBPATH .= ":${LAYERDIR}"

# We have recipes-* directories, add to BBFILES
BBFILES += "${LAYERDIR}/recipes-*/*/*.bb \
            ${LAYERDIR}/recipes-*/*/*.bbappend"

BBFILE_COLLECTIONS += "meta-kiss-st"
BBFILE_PATTERN_meta-kiss-st = "^${LAYERDIR}/"
BBFILE_PRIORITY_meta-kiss-st = "9"

LAYERDEPENDS_meta-kiss-st = "core meta-arm meta-kiss"
LAYERSERIES_COMPAT_meta-kiss-st = "scarthgap"
```

## meta-kiss-ti/conf/layer.conf
```bitbake
# We have a conf and classes directory, add to BBPATH
BBPATH .= ":${LAYERDIR}"

# We have recipes-* directories, add to BBFILES
BBFILES += "${LAYERDIR}/recipes-*/*/*.bb \
            ${LAYERDIR}/recipes-*/*/*.bbappend"

BBFILE_COLLECTIONS += "meta-kiss-ti"
BBFILE_PATTERN_meta-kiss-ti = "^${LAYERDIR}/"
BBFILE_PRIORITY_meta-kiss-ti = "9"

LAYERDEPENDS_meta-kiss-ti = "core meta-arm meta-kiss"
LAYERSERIES_COMPAT_meta-kiss-ti = "scarthgap"
```

## meta-kiss/conf/distro/kiss.conf
```bitbake
# This is an example distro conf. Here is where you can customize the
# policies about how your embedded Linux system should be
# configured. Writing one is so simple that it does not make sense to not
# do it.

DISTRO_NAME = "Keep-it-simple,stupid Linux"
DISTRO_VERSION = "1.0"

# Set features we want on all KISS devices. Also disables any features not
# explicitly mentioned.
DISTRO_FEATURES = "sysvinit ipv4 ipv6 wifi zeroconf usbgadget usbhost pni-names"
```

## meta-kiss/conf/layer.conf
```bitbake
# We have a conf and classes directory, add to BBPATH
BBPATH .= ":${LAYERDIR}"

# We have recipes-* directories, add to BBFILES
BBFILES += "${LAYERDIR}/recipes-*/*/*.bb \
            ${LAYERDIR}/recipes-*/*/*.bbappend"

BBFILE_COLLECTIONS += "meta-kiss"
BBFILE_PATTERN_meta-kiss = "^${LAYERDIR}/"
BBFILE_PRIORITY_meta-kiss = "9"

LAYERDEPENDS_meta-kiss = "core meta-arm"
LAYERSERIES_COMPAT_meta-kiss = "scarthgap"
```

## meta-kiss/conf/machine/dogbonedark.conf
```bitbake
# Machine configuration for the Dogbone Dark product.
#
# This is a fictitious product. These settings are actually for the
# Beaglebone Black.

require include/common.inc

# Adds "ti-soc" and "ti33x" to MACHINEOVERRIDES, and ultimately to
# OVERRIDES
require conf/machine/include/soc-family.inc
SOC_FAMILY = "ti-soc:ti33x"

# Defines instruction sets and tunes for the CPU in the SoC
require conf/machine/include/arm/armv7a/tune-cortexa8.inc
DEFAULTTUNE = "armv7athf-neon"

# Basic info about the hardware
MACHINE_FEATURES = "apm usbgadget usbhost alsa"
SERIAL_CONSOLES = "115200;ttyS0"

# Select kernel recipe, set parameters for kernel build
PREFERRED_PROVIDER_virtual/kernel ?= "linux-kiss"
KERNEL_DEVICETREE = "ti/omap/am335x-boneblack.dtb ti/omap/am335x-boneblack-wireless.dtb"
KERNEL_IMAGETYPE = "zImage"

# Select bootloader recipe, set parameters for bootloader build
PREFERRED_PROVIDER_virtual/bootloader ?= "u-boot-kiss"
UBOOT_ARCH = "arm"
UBOOT_MACHINE = "am335x_evm_config"
UBOOT_MAKE_TARGET = " DEVICE_TREE=am335x-boneblack"
UBOOT_ENTRYPOINT = "0x80008000"
UBOOT_LOADADDRESS = "0x80008000"
UBOOT_BINARY = "u-boot.img"
SPL_BINARY = "MLO"

# We need MLO and u-boot.img in /boot (wic will copy them to the FAT
# partition). Expanding PREFERRED_PROVIDER_virtual/bootloader instead of
# writing u-boot-kiss allows this line to work even in case the bootloader
# is overridden, e.g. via local.conf.
IMAGE_INSTALL:append = " ${PREFERRED_PROVIDER_virtual/bootloader}"
```

## meta-kiss/conf/machine/freiheit93.conf
```bitbake
require include/common.inc
require conf/machine/include/arm/armv8-2a/tune-cortexa55.inc

MACHINE_FEATURES = "usbhost usbgadget alsa serial"

SERIAL_CONSOLES = "115200;ttyLP0"

PREFERRED_PROVIDER_virtual/kernel = "linux-kiss"
KERNEL_DEVICETREE = "freescale/imx93-11x11-frdm.dtb"
KERNEL_IMAGETYPE = "Image"

TFA_PLATFORM = "imx93"
TFA_BUILD_TARGET = "bl31"

IMX_BOOT_SEEK = "32"

PREFERRED_PROVIDER_virtual/bootloader ?= "u-boot-kiss"
MACHINE_ESSENTIAL_EXTRA_RDEPENDS = "u-boot-kiss-extlinux kernel-devicetree"
UBOOT_CONFIG ??= "sd"
UBOOT_CONFIG[sd] = "imx93_frdm_defconfig,sdcard"
DDR_FIRMWARE_NAME = " \
    lpddr4_dmem_1d_v202201.bin \
    lpddr4_dmem_2d_v202201.bin \
    lpddr4_imem_1d_v202201.bin \
    lpddr4_imem_2d_v202201.bin \
"

MACHINE_ESSENTIAL_EXTRA_RDEPENDS += " \
    kernel-module-adp5585 \
    kernel-module-dwmac-imx \
    kernel-module-flexcan \
    kernel-module-imx7ulp-wdt \
    kernel-module-imx93-adc \
    kernel-module-nvmem-imx-ocotp-ele \
    kernel-module-nxp-bbnsm-pwrkey \
    kernel-module-qoriq-thermal \
    kernel-module-reset-gpio \
    kernel-module-rtc-nxp-bbnsm \
    kernel-module-rtc-pcf2127 \
    kernel-module-snd-soc-fsl-asoc-card \
    kernel-module-snd-soc-fsl-mqs \
    kernel-module-snd-soc-fsl-sai \
    kernel-module-spidev \
    kernel-module-tcpci \
"

IMAGE_BOOT_FILES ?= " \
    ${KERNEL_IMAGETYPE} \
    ${@os.path.basename(d.getVar("KERNEL_DEVICETREE"))} \
"
```

## meta-kiss/conf/machine/include/common.inc
```bitbake
# Common definitions for all the KISS machines

# Generate an extlinux configuration file
UBOOT_EXTLINUX = "1"
UBOOT_EXTLINUX_ROOT ?= "root=/dev/mmcblk0p2"
# Install the extlinux conf file in /boot, and also the device tree it needs
MACHINE_ESSENTIAL_EXTRA_RDEPENDS = "u-boot-kiss-extlinux kernel-devicetree"

# Install kernel modules if they are enabled
MACHINE_ESSENTIAL_EXTRA_RRECOMMENDS = "kernel-modules"
```

## meta-kiss/conf/machine/krazymp.conf
```bitbake
# Machine configuration for the KrazyMP product.
#
# This is a fictitious product. These settings are actually for the
# ZynqMP KRIA KD240 Devres Starter Kit.

require include/common.inc

# Adds "zynqmp" to MACHINEOVERRIDES, and ultimately to OVERRIDES
require conf/machine/include/soc-family.inc
SOC_FAMILY = "zynqmp"

# Defines instruction sets and tunes for the two CPUs in the SoC.
# Microblaze instruction are needed to build the PMUFW.
DEFAULTTUNE ?= "cortexa53"
TUNEFILE[cortexa53] = "conf/machine/include/arm/armv8a/tune-cortexa53.inc"
TUNEFILE[microblaze] = "conf/machine/include/microblaze/tune-microblaze.inc"
TUNEFILE = "${@d.getVarFlag('TUNEFILE', d.getVar('DEFAULTTUNE'))}"
require ${TUNEFILE}

# Set ZynqMP microblaze multiconfig to build PMUFW
BBMULTICONFIG = "zynqmp-microblaze"

# Basic info about the hardware
MACHINE_FEATURES = "apm usbgadget usbhost alsa"
SERIAL_CONSOLES = "115200;ttyPS1"

PMUFW_EXTRA_CFLAGS = "-DK24_SOM"

# Select bootloader recipe, set parameters for bootloader build
TFA_PLATFORM = "zynqmp"
TFA_BUILD_TARGET = "bl31"
TFA_EXTRA_OEMAKE = "RESET_TO_BL31=1 ZYNQMP_CONSOLE=cadence1"

# Select bootloader recipe, set parameters for bootloader build
PREFERRED_PROVIDER_virtual/bootloader = "u-boot-kiss"
UBOOT_MACHINE = "xilinx_zynqmp_kria_defconfig"
UBOOT_MAKE_TARGET = " DEVICE_TREE=zynqmp-smk-k24-revA-sck-kd-g-revA"
SPL_BINARY = ""
UBOOT_SUFFIX = "dtb"
UBOOT_ELF = "u-boot"
UBOOT_LOADADDRESS = "0x18000000"
UBOOT_ENTRYPOINT = "0x18000000"
UBOOT_DTB_LOADADDRESS = "0x40000000"

# Set configuration for extlinux file
UBOOT_EXTLINUX_CONSOLE = "console=ttyPS1,115200"
UBOOT_EXTLINUX_FDT = "../zynqmp-smk-k24-revA-sck-kd-g-revA.dtb"
UBOOT_EXTLINUX_ROOT = "root=/dev/sda1"

# Build boot.bin image
EXTRA_IMAGEDEPENDS += "bootbin-xilinx"

# Select kernel recipe, set parameters for kernel build
PREFERRED_PROVIDER_virtual/kernel = "linux-kiss"
KERNEL_DEVICETREE = "xilinx/zynqmp-smk-k24-revA-sck-kd-g-revA.dtb"
KERNEL_IMAGETYPE = "Image"
```

## meta-kiss/conf/machine/stompduck.conf
```bitbake
# Machine configuration for the Stomp Duck product.
#
# This is a fictitious product. These settings are actually for the
# STM32MP157A-DK1.

require include/common.inc

# Adds "stm32mp1" to MACHINEOVERRIDES, and ultimately to OVERRIDES
require conf/machine/include/soc-family.inc
SOC_FAMILY = "stm32mp1"

# Defines instruction sets and tunes for the CPU in the SoC
require conf/machine/include/arm/armv7a/tune-cortexa7.inc
DEFAULTTUNE = "cortexa7thf-neon-vfpv4"

# Basic info about the hardware
MACHINE_FEATURES = "usbhost usbgadget alsa screen pci tpm2"
SERIAL_CONSOLES = "115200;ttySTM0"

# Select kernel recipe, set parameters for kernel build
PREFERRED_PROVIDER_virtual/kernel ?= "linux-kiss"
KERNEL_DEVICETREE = "st/stm32mp157a-dk1.dtb"
KERNEL_IMAGETYPE = "zImage"

# Select bootloader recipe, set parameters for bootloader build
PREFERRED_PROVIDER_virtual/bootloader ?= "u-boot-kiss"
UBOOT_ARCH = "arm"
UBOOT_MACHINE = "stm32mp15_defconfig"
UBOOT_ENTRYPOINT = "0xC0800000"

# Build trusted-firmware-a for STM32MP1
UBOOT_BINARY = "u-boot-nodtb.${UBOOT_SUFFIX}"
UBOOT_MAKE_TARGET:append = " DEVICE_TREE=st/stm32mp157a-dk1"
TFA_PLATFORM = "stm32mp1"
TFA_BUILD_TARGET = "fip all"
TFA_INSTALL_TARGET = "fip tf-a-stm32mp157a-dk1.stm32"
EXTRA_OEMAKE:append:pn-trusted-firmware-a = " \
    ARCH=aarch32 ARM_ARCH_MAJOR=7 \
    AARCH32_SP=optee \
    DTB_FILE_NAME=stm32mp157a-dk1.dtb \
    STM32MP1_OPTEE_IN_SYSRAM=1 \
    BL32=${DEPLOY_DIR_IMAGE}/optee/tee-header_v2.bin \
    BL32_EXTRA1=${DEPLOY_DIR_IMAGE}/optee/tee-pager_v2.bin \
    BL32_EXTRA2=${DEPLOY_DIR_IMAGE}/optee/tee-pageable_v2.bin \
    BL33_CFG=${DEPLOY_DIR_IMAGE}/u-boot.dtb \
    STM32MP_SDMMC=1 \
    BL33=${DEPLOY_DIR_IMAGE}/u-boot-nodtb.bin \
"

# Build optee-os for STM32MP1
OPTEEMACHINE = "stm32mp1"
EXTRA_OEMAKE:append:pn-optee-os = " \
    PLATFORM_FLAVOR=157A_DK1 \
    CFG_STM32MP1_OPTEE_IN_SYSRAM=y \
"

# This machine has the rootfs on partition 5
UBOOT_EXTLINUX_ROOT = "root=/dev/mmcblk0p5"

# Needed to boot (wic will copy it into the flashable image)
WKS_FILE_DEPENDS:append = " trusted-firmware-a"
```
